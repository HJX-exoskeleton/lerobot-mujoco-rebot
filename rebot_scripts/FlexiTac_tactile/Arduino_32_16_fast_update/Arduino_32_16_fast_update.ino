#include <avr/pgmspace.h>

#define BAUD_RATE                 2000000
#define ROW_COUNT                 16
#define COLUMN_COUNT              32

// -----------------------------------------------------
// 引脚映射说明 (基于 ATmega328P):
// Pin 2 (PD2) : 移位寄存器 DATA
// Pin 3 (PD3) : 移位寄存器 CLK
// Pin 4 (PD4) : MUX S0
// Pin 5 (PD5) : MUX S1
// Pin 6 (PD6) : MUX S2
// Pin 7 (PD7) : MUX S3
// Pin 8 (PB0) : MUX INH 0
// Pin 9 (PB1) : MUX INH 1
// Pin A0(PC0) : ADC 模拟输入
// -----------------------------------------------------

#define PIN_ADC_INPUT             A0

// 移位寄存器高速宏定义 (保持你原本的高效设计)
#define SET_SR_DATA_HIGH()        PORTD |= B00000100
#define SET_SR_DATA_LOW()         PORTD &= ~B00000100
#define SET_SR_CLK_HIGH()         PORTD |= B00001000
#define SET_SR_CLK_LOW()          PORTD &= ~B00001000

#define ROWS_PER_MUX              16
#define MUX_COUNT                 1
#define CHANNEL_PINS_PER_MUX      4

// =====================================================
// 标定参数
// =====================================================

// 是否启用逐点偏移标定
#define USE_POINT_OFFSETS         1

// 是否在 Arduino 端额外减去固定阈值
#define USE_ARDUINO_DEADZONE      0
#define DEADZONE_VALUE            15

// =====================================================
// 16×32 点偏移矩阵 (PROGMEM)
// =====================================================

// 16×32的零矩阵：标定初始化时释放注释并烧入
// const uint8_t POINT_OFFSETS[ROW_COUNT][COLUMN_COUNT] PROGMEM = {
//   {0, 0, 0, 0, 0, 0, 0, 0, 0, 0, 0, 0, 0, 0, 0, 0, 0, 0, 0, 0, 0, 0, 0, 0, 0, 0, 0, 0, 0, 0, 0, 0},
//   {0, 0, 0, 0, 0, 0, 0, 0, 0, 0, 0, 0, 0, 0, 0, 0, 0, 0, 0, 0, 0, 0, 0, 0, 0, 0, 0, 0, 0, 0, 0, 0},
//   {0, 0, 0, 0, 0, 0, 0, 0, 0, 0, 0, 0, 0, 0, 0, 0, 0, 0, 0, 0, 0, 0, 0, 0, 0, 0, 0, 0, 0, 0, 0, 0},
//   {0, 0, 0, 0, 0, 0, 0, 0, 0, 0, 0, 0, 0, 0, 0, 0, 0, 0, 0, 0, 0, 0, 0, 0, 0, 0, 0, 0, 0, 0, 0, 0},
//   {0, 0, 0, 0, 0, 0, 0, 0, 0, 0, 0, 0, 0, 0, 0, 0, 0, 0, 0, 0, 0, 0, 0, 0, 0, 0, 0, 0, 0, 0, 0, 0},
//   {0, 0, 0, 0, 0, 0, 0, 0, 0, 0, 0, 0, 0, 0, 0, 0, 0, 0, 0, 0, 0, 0, 0, 0, 0, 0, 0, 0, 0, 0, 0, 0},
//   {0, 0, 0, 0, 0, 0, 0, 0, 0, 0, 0, 0, 0, 0, 0, 0, 0, 0, 0, 0, 0, 0, 0, 0, 0, 0, 0, 0, 0, 0, 0, 0},
//   {0, 0, 0, 0, 0, 0, 0, 0, 0, 0, 0, 0, 0, 0, 0, 0, 0, 0, 0, 0, 0, 0, 0, 0, 0, 0, 0, 0, 0, 0, 0, 0},
//   {0, 0, 0, 0, 0, 0, 0, 0, 0, 0, 0, 0, 0, 0, 0, 0, 0, 0, 0, 0, 0, 0, 0, 0, 0, 0, 0, 0, 0, 0, 0, 0},
//   {0, 0, 0, 0, 0, 0, 0, 0, 0, 0, 0, 0, 0, 0, 0, 0, 0, 0, 0, 0, 0, 0, 0, 0, 0, 0, 0, 0, 0, 0, 0, 0},
//   {0, 0, 0, 0, 0, 0, 0, 0, 0, 0, 0, 0, 0, 0, 0, 0, 0, 0, 0, 0, 0, 0, 0, 0, 0, 0, 0, 0, 0, 0, 0, 0},
//   {0, 0, 0, 0, 0, 0, 0, 0, 0, 0, 0, 0, 0, 0, 0, 0, 0, 0, 0, 0, 0, 0, 0, 0, 0, 0, 0, 0, 0, 0, 0, 0},
//   {0, 0, 0, 0, 0, 0, 0, 0, 0, 0, 0, 0, 0, 0, 0, 0, 0, 0, 0, 0, 0, 0, 0, 0, 0, 0, 0, 0, 0, 0, 0, 0},
//   {0, 0, 0, 0, 0, 0, 0, 0, 0, 0, 0, 0, 0, 0, 0, 0, 0, 0, 0, 0, 0, 0, 0, 0, 0, 0, 0, 0, 0, 0, 0, 0},
//   {0, 0, 0, 0, 0, 0, 0, 0, 0, 0, 0, 0, 0, 0, 0, 0, 0, 0, 0, 0, 0, 0, 0, 0, 0, 0, 0, 0, 0, 0, 0, 0},
//   {0, 0, 0, 0, 0, 0, 0, 0, 0, 0, 0, 0, 0, 0, 0, 0, 0, 0, 0, 0, 0, 0, 0, 0, 0, 0, 0, 0, 0, 0, 0, 0}
// };


// 使用multi_thread_contact_v0.py代码：标定完成时覆盖触觉矩阵后释放注释并烧入
const uint8_t POINT_OFFSETS[ROW_COUNT][COLUMN_COUNT] PROGMEM = {
{ 0, 0, 0, 0, 0, 0, 0, 0, 0, 0, 0, 0, 0, 0, 0, 0, 0, 0, 0, 0, 0, 0, 0, 0, 0, 0, 0, 0, 0, 0, 0, 0 },
{ 0, 0, 0, 0, 0, 0, 0, 0, 0, 0, 0, 0, 0, 0, 0, 0, 0, 0, 0, 0, 0, 0, 0, 0, 0, 0, 0, 0, 0, 0, 0, 0 },
{ 0, 0, 0, 0, 0, 0, 0, 0, 0, 0, 0, 0, 0, 0, 0, 0, 0, 0, 0, 0, 0, 0, 0, 0, 0, 0, 0, 0, 0, 0, 0, 0 },
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{ 0, 0, 0, 0, 0, 0, 0, 0, 0, 0, 0, 0, 0, 0, 0, 0, 0, 0, 1, 0, 0, 0, 0, 0, 0, 0, 0, 0, 0, 0, 0, 2 },
};


int current_enabled_mux = MUX_COUNT - 1;

// =====================================================
// 初始化
// =====================================================
void setup()
{
  Serial.begin(BAUD_RATE);

  // 1. 引脚模式初始化 - 寄存器级替换 pinMode
  // 将 PC0 (A0) 设为输入
  DDRC &= ~_BV(PC0);   
  PORTC &= ~_BV(PC0);  // 禁用内部上拉电阻

  // 将 PD2~PD7 (对应 Pin 2~7) 设为输出
  // PD2,3: Shift Reg / PD4,5,6,7: MUX S0-S3
  DDRD |= B11111100;

  // 将 PB0~PB1 (对应 Pin 8~9) 设为输出
  // PB0: MUX INH 0 / PB1: MUX INH 1
  DDRB |= B00000011;

  // 默认先关闭所有 MUX (将 PB0 和 PB1 拉高)
  PORTB |= B00000011;

  // 2. ADC 寄存器终极优化
  // 启用 ADC (ADEN)
  ADCSRA |= _BV(ADEN);
  
  // 设置预分频器 (Prescaler) 为 16 -> ADPS2=1, ADPS1=0, ADPS0=0
  // 此时 ADC 频率 = 16MHz / 16 = 1MHz，采样极快
  ADCSRA = (ADCSRA & 0xF8) | 0x04; 

  // 设置 ADC 基准电压为 AVCC (REFS0=1), 且选择通道 A0 (MUX3:0 = 0000)
  ADMUX = _BV(REFS0) | 0; 
}


// =====================================================
// 主循环
// =====================================================
void loop()
{
  // 帧头
  Serial.write(0xAA);
  Serial.write(0x55);

  for (int i = 0; i < ROW_COUNT; i++)
  {
    setRow(i);

    shiftColumn(true);
    shiftColumn(false);

    for (int j = 0; j < COLUMN_COUNT; j++)
    {
      // ---------------------------------------------------
      // 寄存器级的高速 ADC 读取 (完美替代 analogRead)
      // ---------------------------------------------------
      ADCSRA |= _BV(ADSC);          // 触发一次 ADC 转换
      while (ADCSRA & _BV(ADSC));   // 挂起等待转换完成位清零
      int raw_reading = ADC;        // 提取底层的 10-bit 数据

      uint8_t send_reading = (uint8_t)(raw_reading >> 2);
      int calibrated_reading = send_reading;

#if USE_POINT_OFFSETS
      uint8_t point_offset = pgm_read_byte(&(POINT_OFFSETS[i][j]));
      calibrated_reading -= point_offset;
#endif

#if USE_ARDUINO_DEADZONE
      calibrated_reading -= DEADZONE_VALUE;
#endif

      if (calibrated_reading < 0) {
        calibrated_reading = 0;
      } else if (calibrated_reading > 255) {
        calibrated_reading = 255;
      }

      Serial.write((uint8_t)calibrated_reading);

      shiftColumn(false);
    }
  }
}


// =====================================================
// 设置当前扫描行 - 寄存器级优化
// =====================================================
void setRow(int row_number)
{
  // 1. 处理 MUX 的使能/禁用 (原先的 PIN_MUX_INHIBIT 逻辑)
  if ((row_number % ROWS_PER_MUX) == 0)
  {
    // digitalWrite(PIN_MUX_INHIBIT_0 + current_enabled_mux, HIGH);
    // PB0 和 PB1 对应 INH0 和 INH1，直接用位移操作拉高
    PORTB |= _BV(current_enabled_mux);

    current_enabled_mux++;
    if (current_enabled_mux >= MUX_COUNT) {
      current_enabled_mux = 0;
    }

    // digitalWrite(PIN_MUX_INHIBIT_0 + current_enabled_mux, LOW);
    PORTB &= ~_BV(current_enabled_mux);
  }

  // 2. 处理 MUX 的通道选择 S0~S3
  // 原理：Pin 4,5,6,7 正好完美对应 ATmega328P 的 PD4, PD5, PD6, PD7
  // 因此我们只需要把 0-15 的 row_number 左移 4 位，直接塞进 PORTD 寄存器中，
  // 这相当于只用 1 条指令代替了之前的 4 次 digitalWrite 和 bitRead，提速百倍！
  
  // 先把 PD4~PD7 清零，保留 PD0~PD3 状态不变
  PORTD &= B00001111;
  // 取出 row_number 的低 4 位，左移 4 位填入 PD4~PD7
  PORTD |= ((row_number & 0x0F) << 4);
}


// =====================================================
// 控制移位寄存器切换列 (已是高效宏定义，无需改变)
// =====================================================
void shiftColumn(boolean is_first)
{
  if (is_first) {
    SET_SR_DATA_HIGH();
  }

  SET_SR_CLK_HIGH();
  SET_SR_CLK_LOW();

  if (is_first) {
    SET_SR_DATA_LOW();
  }
}